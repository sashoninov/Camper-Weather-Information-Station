## sdkconfig.defaults
```kconfig
# --- Target ---
CONFIG_IDF_TARGET="esp32p4"

# --- Flash ---
CONFIG_ESPTOOLPY_FLASHMODE_QIO=y
CONFIG_ESPTOOLPY_FLASHSIZE_16MB=y

# --- Partition Table ---
CONFIG_PARTITION_TABLE_CUSTOM=y

# --- Compiler ---
CONFIG_COMPILER_OPTIMIZATION_PERF=y

# --- PSRAM ---
CONFIG_SPIRAM=y
CONFIG_SPIRAM_SPEED_200M=y
CONFIG_SPIRAM_XIP_FROM_PSRAM=y

# --- Cache (optimized for display performance) ---
CONFIG_CACHE_L2_CACHE_256KB=y
CONFIG_CACHE_L2_CACHE_LINE_128B=y

# --- FreeRTOS ---
CONFIG_ESP_MAIN_TASK_STACK_SIZE=10240
CONFIG_FREERTOS_HZ=1000

# --- Experimental features (required for ESP32-P4 MIPI DSI) ---
CONFIG_IDF_EXPERIMENTAL_FEATURES=y

# --- LVGL Configuration ---
CONFIG_LV_COLOR_SCREEN_TRANSP=y
CONFIG_LV_MEM_CUSTOM=y
CONFIG_LV_MEMCPY_MEMSET_STD=y
CONFIG_LV_DISP_DEF_REFR_PERIOD=15
CONFIG_LV_ATTRIBUTE_FAST_MEM_USE_IRAM=y

# Fonts for LVGL
CONFIG_LV_FONT_MONTSERRAT_48=y

### sdkconfig for ESP32-P4 + C6 Dev board
CONFIG_SLAVE_IDF_TARGET_ESP32C6=y
CONFIG_ESP_HOSTED_CP_TARGET_ESP32C6=y
CONFIG_ESP_HOSTED_P4_DEV_BOARD_FUNC_BOARD=y

CONFIG_WIFI_RMT_STATIC_RX_BUFFER_NUM=16
CONFIG_WIFI_RMT_DYNAMIC_RX_BUFFER_NUM=64
CONFIG_WIFI_RMT_DYNAMIC_TX_BUFFER_NUM=64
CONFIG_WIFI_RMT_AMPDU_TX_ENABLED=y
CONFIG_WIFI_RMT_TX_BA_WIN=32
CONFIG_WIFI_RMT_AMPDU_RX_ENABLED=y
CONFIG_WIFI_RMT_RX_BA_WIN=32

CONFIG_LWIP_TCP_SND_BUF_DEFAULT=65534
CONFIG_LWIP_TCP_WND_DEFAULT=65534
CONFIG_LWIP_TCP_RECVMBOX_SIZE=64
CONFIG_LWIP_UDP_RECVMBOX_SIZE=64
CONFIG_LWIP_TCPIP_RECVMBOX_SIZE=64

CONFIG_LWIP_TCP_SACK_OUT=y

# --- Disable auto-start of ESP-Hosted WiFi (CRITICAL FIX) ---
CONFIG_ESP_HOSTED_AUTO_INIT=n

CONFIG_LITTLEFS_FOR_IDF=y
```
